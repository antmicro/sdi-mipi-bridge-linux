## nvidia/drivers/media/spi/Kconfig
```kconfig
config VIDEO_IMX204
	tristate "IMX204 camera sensor support"
	depends on SPI && VIDEO_V4L2 && VIDEO_V4L2_SUBDEV_API
        select REGMAP_SPI
	---help---
	  This is a Video4Linux2 sensor-level driver for the Sony
	  IMX204 camera sensor

	  To compile this driver as a module, choose M here: the module
	  will be called imx204.

config VIDEO_GS2971A
	tristate "Semtech GS2971A support"
	depends on SPI && VIDEO_V4L2 && VIDEO_V4L2_SUBDEV_API
	---help---
	  This is a Video4Linux2 sensor-level driver for Semtech GS2971A
	  deserializer.

	  To compile this driver as a module, choose M here: the module
	  will be called gs2971a.
```
